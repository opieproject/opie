## noncore/applets/pyquicklaunch/config.in
```kconfig
  config PYQUICKLAUNCH
    boolean "python-quicklaunchapplet (show status of and control the python quicklauncher)"
    default "n"
    depends ( LIBQPE || LIBQPE-X11 ) && LIBOPIE2CORE
```

## noncore/applets/volumeapplet2/config.in
```kconfig
  config VOLUMEAPPLET2
    boolean "opie-volumeapplet2 (control mixer volume on-the-fly)"
    default "n"
    depends ( LIBQPE || LIBQPE-X11 ) && LIBOPIE2CORE && LIBOPIE2UI && LIBOPIE2MM
    comment "Volume applet needs a libqpe and libopie2 (core, ui, mm)"
    depends !(( LIBQPE || LIBQPE-X11 ) && LIBOPIE2CORE && LIBOPIE2UI && LIBOPIE2MM)
```

## noncore/applets/wirelessapplet/config.in
```kconfig
  config WIRELESSAPPLET
    boolean "Wireless (view wireless signal strength, and renew IP on AP change)"
    default "y"
    depends ( LIBQPE || LIBQPE-X11 ) && LIBOPIE
```

## noncore/applets/zkbapplet/config.in
```kconfig
  config ZKBAPPLET
    boolean "zkbapplet (Switch hardware keyboard layout on the fly)"
    default "y"
    depends ( LIBQPE || LIBQPE-X11 )
```

## noncore/apps/advancedfm/config.in
```kconfig
  config ADVANCEDFM
    boolean "opie-advancedfm (advanced file manager)"
    default "y"
    depends ( LIBQPE || LIBQPE-X11 ) && LIBOPIE
```

## noncore/apps/checkbook/config.in
```kconfig
  config CHECKBOOK
    boolean "opie-checkbook (keep track of issued cheques)"
    default "y"
    depends ( LIBQPE || LIBQPE-X11 ) && LIBOPIE
```

## noncore/apps/confedit/config.in
```kconfig
  config CONFEDIT
    boolean "opie-confedit (generic editor for all Opie settings)"
    default "y"
    depends ( LIBQPE || LIBQPE-X11 ) && LIBOPIE2CORE
```

## noncore/apps/dagger/config.in
```kconfig
  config DAGGER
    boolean "opie-dagger (Bible study/reader application - requires libsword)"
    default "n"
    depends ( LIBQPE || LIBQPE-X11 ) && LIBOPIE2CORE && LIBOPIE2UI
```

## noncore/apps/keyz-cfg/config.in
```kconfig
  config KEYZCFG
    boolean "keyz-cfg (configuration tool for keyz applet)"
    default "n"
    depends ( LIBQPE || LIBQPE-X11 ) && LIBOPIE2CORE
```

## noncore/apps/odict/config.in
```kconfig
  config ODICT
    boolean "opie-odict (electronic dictionary)"
    default "n"
    depends ( LIBQPE || LIBQPE-X11 ) && LIBOPIE2CORE && LIBOPIE2UI
```

## noncore/apps/opie-bartender/config.in
```kconfig
  config BARTENDER
    boolean "bartender - bar receipe and blood alcohol estimator"
    default "y"
    depends ( LIBQPE || LIBQPE-X11 ) && LIBOPIE2CORE
```

## noncore/apps/opie-console/config.in
```kconfig
  config OPIE-CONSOLE
    boolean "opie-console (scriptable terminal program)"
    default "y"
    depends ( LIBQPE || LIBQPE-X11 ) && LIBOPIE
```

## noncore/apps/opie-gutenbrowser/config.in
```kconfig
  config GUTENBROWSER
    boolean "gutenbrowser - Gutenberg Project etext reader and selector"
    default "y"
    depends ( LIBQPE || LIBQPE-X11 ) && FTPLIB && LIBOPIE2CORE && LIBOPIE2UI
    comment "gutenbrowser needs a libqpe, ftplib, libopie2core and libopie2ui"
    depends !(( LIBQPE || LIBQPE-X11 ) && FTPLIB && LIBOPIE2CORE && LIBOPIE2UI)
```

## noncore/apps/opie-reader/FliteDyn/config.in
```kconfig
  config OPIE-READER-FLITEDYN
    boolean "opie-reader flite plugin (speech output via lib in 8kHz)"
    default "n"
    depends OPIE-READER && LIBFLITE_DEP
    comment "opie-reader flite plugin needs libflite"
    depends !( OPIE-READER && LIBFLITE_DEP )
```

## noncore/apps/opie-reader/FliteDyn16/config.in
```kconfig
  config OPIE-READER-FLITEDYN16
    boolean "opie-reader flite plugin (speech output via lib in 16kHz)"
    default "n"
    depends OPIE-READER && LIBFLITE_DEP
    comment "opie-reader flite plugin needs libflite"
    depends !( OPIE-READER && LIBFLITE_DEP )
```

## noncore/apps/opie-reader/config.in
```kconfig
  config OPIE-READER
    boolean "opie-reader (E-Text reader)"
    default "y"
    depends ( LIBQPE || LIBQPE-X11 ) && LIBOPIE2CORE && LIBOPIE2UI

  source noncore/apps/opie-reader/FliteDyn/config.in
  source noncore/apps/opie-reader/FliteDyn16/config.in
  
```

## noncore/apps/opie-sheet/config.in
```kconfig
  config OPIE-SHEET
    boolean "opie-sheet (spreadsheet calculation program)"
    default "y"
    depends ( LIBQPE || LIBQPE-X11 ) && LIBOPIE
```

## noncore/apps/opie-write/config.in
```kconfig
  config OPIE-WRITE
    boolean "opie-write (rich text editor)"
    default "y"
    depends ( LIBQPE || LIBQPE-X11 ) && LIBOPIE2CORE
```

## noncore/apps/oxygen/config.in
```kconfig
  config OXYGEN
    boolean "opie-oxygen (Periodic System of the Elements)"
    default "y"
    depends ( LIBQPE || LIBQPE-X11 ) && LIBOPIE
```

## noncore/apps/qashmoney/config.in
```kconfig
  config QASHMONEY
    boolean "opie-qashmoney (money manager)" 
    default "n"
    depends ( LIBQPE || LIBQPE-X11 ) && LIBOPIE
```

## noncore/apps/tableviewer/config.in
```kconfig
  config TABLEVIEWER
    boolean "opie-tableviewer (XML database browser)"
    default "y"
    depends ( LIBQPE || LIBQPE-X11 ) && LIBOPIE
```

## noncore/apps/tinykate/config.in
```kconfig
config TINYKATE
  boolean "opie-tinykate (programmers editor Kate from KDE)"
  default "y"
  depends ( LIBQPE || LIBQPE-X11 ) && LIBOPIE2CORE && LIBOPIE2UI && LIBQTAUX
  comment "opie-tinykate needs a libqpe, libopie2core, libopie2ui and libqtaux"
  depends !(( LIBQPE || LIBQPE-X11 ) && LIBOPIE2CORE && LIBOPIE2UI && LIBQTAUX)
```

## noncore/apps/tinykate/libkate/config.in
```kconfig
  config LIBKATE
    boolean "libkate"
    default "y"
    depends ( LIBQPE || LIBQPE-X11 ) && LIBQTAUX && LIBOPIE2CORE && LIBOPIE2UI
```

## noncore/apps/zsafe/config.in
```kconfig
config ZSAFE
    boolean "zsafe (Zaurus Password Manager)"
    default "y"
    depends ( LIBQPE || LIBQPE-X11 ) && LIBOPIE
```

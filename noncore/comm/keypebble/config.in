## noncore/comm/keypebble/config.in
```kconfig
  config KEYPEBBLE
    boolean "opie-keypebble (Virtual Network Computing VNC viewer)"
    default "y"
    depends ( LIBQPE || LIBQPE-X11 ) && LIBOPIE
```

## noncore/comm/mobilemsg/config.in
```kconfig
  config MOBILEMSG
    boolean "opie-mobilemsg (send SMS messages)"
    default "y"
    depends ( LIBQPE || LIBQPE-X11 ) && LIBOPIE
```

## noncore/decorations/flat/config.in
```kconfig
  config DECO_FLAT
    boolean "opie-deco-flat (Flat window decoration style)"
    default "y"
    depends ( LIBQPE || LIBQPE-X11 )
```

## noncore/decorations/liquid/config.in
```kconfig
  config DECO_LIQUID
    boolean "opie-deco-liquid (Liquid (KDE3) window decoration style)"
    default "y"
    depends ( LIBQPE || LIBQPE-X11 )
```

## noncore/decorations/polished/config.in
```kconfig
  config DECO_POLISHED
    boolean "opie-deco-polished (Blended window decoration style)"
    default "y"
    depends ( LIBQPE || LIBQPE-X11 )
```

## noncore/games/backgammon/config.in
```kconfig
  config BACKGAMMON
    boolean "opie-backgammon (Backgammon game)"
    default "y"
    depends ( LIBQPE || LIBQPE-X11 ) && LIBOPIE2CORE
```

## noncore/games/bounce/config.in
```kconfig
  config BOUNCE
    boolean "opie-bounce (a JezzGame like game)"
    default "y"
    depends ( LIBQPE || LIBQPE-X11 ) && LIBOPIE
```

## noncore/games/buzzword/config.in
```kconfig
  config BUZZWORD
    boolean "opie-buzzword (a BuzzWord Bingo)"
    default "y"
    depends ( LIBQPE || LIBQPE-X11 ) && LIBOPIE
```

## noncore/games/chess/config.in
```kconfig
  config CHESS
    boolean "chess"
    default "n"
    depends ( LIBQPE || LIBQPE-X11 ) && LIBOPIE
```

## noncore/games/fifteen/config.in
```kconfig
  config FIFTEEN
    boolean "opie-fifteen (sort fifteen pieces game)"
    default "y"
    depends ( LIBQPE || LIBQPE-X11 ) && LIBOPIE2CORE
```

## noncore/games/go/config.in
```kconfig
  config GO
    boolean "opie-go (the asian game of Go)"
    default "y"
    depends ( LIBQPE || LIBQPE-X11 ) && LIBOPIE2CORE
```

## noncore/games/kbill/config.in
```kconfig
  config KBILL
    boolean "opie-kbill (hit Bill before he can infect your network with a wannabe OS)"
    default "y"
    depends ( LIBQPE || LIBQPE-X11 ) && LIBOPIE
```

## noncore/games/kcheckers/config.in
```kconfig
  config KCHECKERS
    boolean "opie-kcheckers (the game of Checkers)"
    default "y"
    depends ( LIBQPE || LIBQPE-X11 ) && LIBOPIE
```

## noncore/games/kpacman/config.in
```kconfig
  config KPACMAN
    boolean "opie-kpacman (a PacMan clone)"
    default "y"
    depends ( LIBQPE || LIBQPE-X11 ) && LIBOPIE
```

## noncore/games/mindbreaker/config.in
```kconfig
  config MINDBREAKER
    boolean "opie-mindbreaker (crack the coloured code)"
    default "y"
    depends ( LIBQPE || LIBQPE-X11 ) && LIBOPIE2CORE
```

## noncore/games/oyatzee/config.in
```kconfig
  config YATZEE
    boolean "opie-oyatzee (yatzee game)"
    default "n"
    depends ( LIBQPE || LIBQPE-X11 ) && LIBOPIE2CORE
```

## noncore/games/parashoot/config.in
```kconfig
  config PARASHOOT
    boolean "opie-parashoot (shoot the parachutists)"
    default "y"
    depends ( LIBQPE || LIBQPE-X11 ) && LIBOPIE2CORE
```

## noncore/games/qasteroids/config.in
```kconfig
  config QASTEROIDS
    boolean "opie-qasteroids (shoot the asteroids)"
    default "y"
    depends ( LIBQPE || LIBQPE-X11 ) && LIBOPIE
```

## noncore/games/sfcave-sdl/config.in
```kconfig
  config SFCAVE-SDL
    boolean "sfcave-sdl (SDL version of this game, needs the proper libraries)"
    default "y"
    depends ( LIBQPE || LIBQPE-X11 ) && LIBOPIE2CORE && LIBSDL_DEP
```

## noncore/games/sfcave/config.in
```kconfig
  config SFCAVE
    boolean "opie-sfcave (fly the dot though the cave avoiding the walls)"
    default "y"
    depends ( LIBQPE || LIBQPE-X11 ) && LIBOPIE2CORE
```

## noncore/games/snake/config.in
```kconfig
  config SNAKE
    boolean "opie-snake (control eating and growing snake)"
    default "y"
    depends ( LIBQPE || LIBQPE-X11 ) && LIBOPIE
```

## noncore/games/solitaire/config.in
```kconfig
  config SOLITAIRE
    boolean "opie-solitaire (solitaire card game)"
    default "y"
    depends ( LIBQPE || LIBQPE-X11 ) && LIBOPIE
```

## noncore/games/tetrix/config.in
```kconfig
  config TETRIX
    boolean "opie-tetrix (control the falling blocks)"
    default "y"
    depends ( LIBQPE || LIBQPE-X11 ) && LIBOPIE
```

## noncore/games/tictac/config.in
```kconfig
  config TICTAC
    boolean "opie-tictac (Tic Tac Toe, I have three in a row)"
    default "y"
    depends ( LIBQPE || LIBQPE-X11 ) && LIBOPIE
```

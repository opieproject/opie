## noncore/settings/networksettings/interfaces/config.in
```kconfig
  config INTERFACES
    boolean "Build interfaces for networksettings"
    default "y"
    depends ( LIBQPE || LIBQPE-X11 ) && LIBOPIE2CORE
```

## noncore/settings/networksettings/ppp/config.in
```kconfig
  config PPP
    boolean "opie-networksettingsplugin-kppp (PPP module)"
    default "y"
    depends ( LIBQPE || LIBQPE-X11 ) && NETWORKSETUP && NETWORKSETUP-CORE && INTERFACES
```

## noncore/settings/networksettings/wlan/config.in
```kconfig
  config WLAN
    boolean "opie-networksettingsplugin-wlan (wireless LAN module)"
    default "n" if NETWORKSETUP
    depends ( LIBQPE || LIBQPE-X11 ) && LIBOPIE2UI && NETWORKSETUP && NETWORKSETUP-CORE && INTERFACES && LIBOPIE2NET
    #comment "opie-networksettingsplugin-wlan needs libopie2ui, libopie2net and networksetup"
    #depends !( LIBOPIE2NET && NETWORKSETUP)
```

## noncore/settings/networksettings2/bluetooth/config.in
```kconfig
  config NS2BT
    boolean "opie-networksettings2plugin-bluetooth (set up BLUETOOTH)"
    default "n" if NS2
    depends ( LIBQPE || LIBQPE-X11 ) && LIBOPIE2CORE && NS2CORE && NS2OPIETOOTH && LIBBLUEZ_DEP
```

## noncore/settings/networksettings2/cable/config.in
```kconfig
  config NS2CABLE
    boolean "opie-networksettings2plugin-cable (set up Cable)"
    default "n" if NS2
    depends ( LIBQPE || LIBQPE-X11 ) && LIBOPIE && NS2 && NS2CORE
```

## noncore/settings/networksettings2/config.in
```kconfig
  source noncore/settings/networksettings2/networksettings2/config.in
  source noncore/settings/networksettings2/opietooth2/config.in
  source noncore/settings/networksettings2/opietooth2_applet/config.in

config NS2
  boolean "opie-networksettings2 application"
  default "y"
  depends ( LIBQPE || LIBQPE-X11 ) && LIBOPIE2CORE && NS2CORE && NS2OPIETOOTH

  source noncore/settings/networksettings2/profile/config.in
  source noncore/settings/networksettings2/network/config.in
  source noncore/settings/networksettings2/lancard/config.in
  source noncore/settings/networksettings2/ppp/config.in
  source noncore/settings/networksettings2/wlan/config.in
  source noncore/settings/networksettings2/usb/config.in
  source noncore/settings/networksettings2/irda/config.in
  source noncore/settings/networksettings2/vpn/config.in
  source noncore/settings/networksettings2/bluetooth/config.in
  source noncore/settings/networksettings2/cable/config.in
  source noncore/settings/networksettings2/modem/config.in
  source noncore/settings/networksettings2/gprs/config.in
```

## noncore/settings/networksettings2/gprs/config.in
```kconfig
  config NS2GPRS
    boolean "opie-networksettings2plugin-gprs (set up GPRS)"
    default "n" if NS2
    depends ( LIBQPE || LIBQPE-X11 ) && LIBOPIE2CORE && NS2CORE
```

## noncore/settings/networksettings2/irda/config.in
```kconfig
  config NS2IRDA
    boolean "opie-networksettings2plugin-irda (set up IRDA)"
    default "n" if NS2MAIN
    depends ( LIBQPE || LIBQPE-X11 ) && LIBOPIE2CORE && NS2MAIN && NS2CORE
```

## noncore/settings/networksettings2/lancard/config.in
```kconfig
  config NS2LANCARD
    boolean "opie-networksettings2plugin-lancard (regular wired lan card)"
    default "n" if NS2MAIN
    depends ( LIBQPE || LIBQPE-X11 ) && LIBOPIE2CORE && NS2MAIN && NS2CORE
```

## noncore/settings/networksettings2/modem/config.in
```kconfig
  config NS2MODEM
    boolean "opie-networksettings2plugin-modem (set up DIALUP)"
    default "n" if NS2MAIN
    depends ( LIBQPE || LIBQPE-X11 ) && LIBOPIE2CORE && NS2MAIN && NS2CORE
```

## noncore/settings/networksettings2/network/config.in
```kconfig
  config NS2NETWORK
    boolean "opie-networksettings2plugin-ipsetup (set up TCP/IP)"
    default "n" if NS2
    depends ( LIBQPE || LIBQPE-X11 ) && LIBOPIE && NS2 && NS2CORE
```

## noncore/settings/networksettings2/networksettings2/config.in
```kconfig
config NS2CORE
  boolean "opie-networksettings2 library"
  default "y"
  depends ( LIBQPE || LIBQPE-X11 ) && LIBOPIE2CORE && LIBOPIE2UI
```

## noncore/settings/networksettings2/opietooth2/config.in
```kconfig
config NS2OPIETOOTH
  boolean "Opietooth2 bluetooth library"
  default "y"
  depends ( LIBQPE || LIBQPE-X11 ) && LIBOPIE2CORE && LIBBLUEZ_DEP && NS2CORE
```

## noncore/settings/networksettings2/opietooth2_applet/config.in
```kconfig
  config NS2OPIETOOTHAPPLET
    boolean "opietooth2 bluetooth applet"
    default "y"
    depends ( LIBQPE || LIBQPE-X11 ) && LIBOPIE2CORE && NS2OPIETOOTH
```

## noncore/settings/networksettings2/ppp/config.in
```kconfig
  config NS2PPP
    boolean "opie-networksettings2plugin-ppp (set up PPP)"
    default "n" if NS2MAIN
    depends ( LIBQPE || LIBQPE-X11 ) && LIBOPIE2CORE && NS2MAIN && NS2CORE
```

## noncore/settings/networksettings2/profile/config.in
```kconfig
  config NS2PROFILE
    boolean "opie-networksettings2plugin-profiles (User profiles)"
    default "n" if NS2MAIN
    depends ( LIBQPE || LIBQPE-X11 ) && LIBOPIE2CORE && NS2MAIN && NS2CORE
```

## noncore/settings/networksettings2/usb/config.in
```kconfig
  config NS2USB
    boolean "opie-networksettings2plugin-usb (set up USB)"
    default "n" if NS2MAIN
    depends ( LIBQPE || LIBQPE-X11 ) && LIBOPIE2CORE && NS2MAIN && NS2CORE
```

## noncore/settings/networksettings2/vpn/config.in
```kconfig
  config NS2VPN
    boolean "opie-networksettings2plugin-vpn (set up VPN)"
    default "n" if NS2MAIN
    depends ( LIBQPE || LIBQPE-X11 ) && LIBOPIE2CORE && NS2MAIN && NS2CORE
```

## noncore/settings/networksettings2/wlan/config.in
```kconfig
  config NS2WLAN
    boolean "opie-networksettings2plugin-wlan (set up Wireless LAN)"
    default "n" if NS2MAIN
    depends ( LIBQPE || LIBQPE-X11 ) && LIBOPIE2CORE && NS2MAIN && NS2CORE
```

## noncore/settings/packagemanager/config.in
```kconfig
  config PACKAGEMANAGER
    boolean "opie-packagemanager (package management client)"
    default "y"
    depends ( LIBQPE || LIBQPE-X11 ) && LIBOPIE2CORE && LIBOPIE2UI && LIBIPK_DEP
```

## noncore/settings/sound/config.in
```kconfig
  config SOUND
    boolean "opie-vmemo-settings (control sound settings for the vmemo app)"
    default "y"
    depends ( LIBQPE || LIBQPE-X11 ) && LIBOPIE
```

## noncore/settings/sshkeys/config.in
```kconfig
  config SSHKEYS
    boolean "opie-sshkeys (manage ssh-agent keys)"
    default "y"
    depends ( LIBQPE || LIBQPE-X11 ) && LIBOPIE
```

## noncore/settings/sysinfo/config.in
```kconfig
  config SYSINFO
    boolean "opie-sysinfo (System Information dialog)"
    default "y"
    depends ( LIBQPE || LIBQPE-X11 ) && LIBOPIE2CORE && LIBOPIE2UI
    comment "opie-sysinfo needs a libqpe, libopie2core, libopie2ui"
    depends !( ( LIBQPE || LIBQPE-X11 ) && LIBOPIE2CORE && LIBOPIE2UI )
```

## noncore/settings/tabmanager/config.in
```kconfig
  config TABMANAGER
    boolean "opie-tabmanager (menu editor for the Opie taskbar)"
    default "y"
    depends ( LIBQPE || LIBQPE-X11 ) && LIBOPIE
```

## noncore/settings/usermanager/config.in
```kconfig
  config USERMANAGER
    boolean "opie-usermanager (User/Group manager)"
    default "y"
    depends ( LIBQPE || LIBQPE-X11 ) && LIBOPIE2CORE && LIBOPIE2UI
```

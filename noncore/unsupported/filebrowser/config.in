## noncore/unsupported/filebrowser/config.in
```kconfig
  config FILEBROWSER
    boolean "opie-filebrowser (file manager)"
    default "y"
    depends ( LIBQPE || LIBQPE-X11 ) && LIBOPIE
```

## noncore/unsupported/gsmtool/config.in
```kconfig
  config GSMTOOL
    boolean "opie-gsmtool (an GSM phone utility program)"
    default "n"
    depends ( LIBQPE || LIBQPE-X11 ) && LIBOPIE
```

## noncore/unsupported/mail2/bend/config.in
```kconfig
config BEND
   boolean "opie-mailapplet (a biff-like mailchecker)"
   default "y" if MAIL
   depends ( LIBQPE || LIBQPE-X11 ) && LIBMAIL && LIBOPIE && MAIL
```

## noncore/unsupported/mail2/config.in
```kconfig
 config OPIEMAIL2
    boolean "opie-mail2 (an IMAP mail client)"
    default "y"
    depends ( LIBQPE || LIBQPE-X11 ) && LIBOPIE && BEND && LIBMAIL && MAIL

  source noncore/unsupported/mail2/bend/config.in
  source noncore/unsupported/mail2/libmail/config.in
```

## noncore/unsupported/mail2/libmail/config.in
```kconfig
  config LIBMAIL
    boolean "libmail"
    default "y" if MAIL
    depends ( LIBQPE || LIBQPE-X11 ) && LIBOPIE && MAIL
```

## noncore/unsupported/mailit/config.in
```kconfig
  config MAILIT
    boolean "opie-mailit (a simple POP3 email client)"
    default "n"
    depends ( LIBQPE || LIBQPE-X11 ) 
```

## noncore/unsupported/mobilemsg/config.in
```kconfig
  config MOBILEMSG
    boolean "opie-mobilemsg (send SMS messages)"
    default "n"
    depends ( LIBQPE || LIBQPE-X11 )
```

## noncore/unsupported/oipkg/config.in
```kconfig
  config OIPKG
    boolean "opie-oipkg (manager for *.ipk software packages)"
    default "y"
    depends ( LIBQPE || LIBQPE-X11 ) && LIBOPIE
```

## noncore/unsupported/qpdf/config.in
```kconfig
  config QPDF
    boolean "opie-qpdf (a PDF viewer)"
    default "y"
    depends ( LIBQPE || LIBQPE-X11 ) && LIBOPIE
```

## noncore/unsupported/qws/config.in
```kconfig
  config QWS
    boolean "Minimal QWS Server"
    default "n"
    depends ( LIBQPE || LIBQPE-X11 ) && LIBOPIE2CORE && LIBOPIE2UI && EXPERIMENTAL
```

## noncore/unsupported/showimg/config.in
```kconfig
  config SHOWIMG
    boolean "opie-showimg (image viewer)"
    default "n"
    depends ( LIBQPE || LIBQPE-X11 ) && LIBOPIE2CORE && LIBOPIE2UI
```

## x11/config.in
```kconfig
  config X11
    boolean "Qpe Library (Qt/X11 version)"

  source x11/libqpe-x11/config.in
  source x11/ipc/server/config.in
```

## x11/ipc/server/config.in
```kconfig
config OCOPSERVER
  boolean "OCop Server"
  default "y" if X11
  default "n" if ! X11
  depends on X11
```

## x11/libqpe-x11/config.in
```kconfig
config LIBQPE-X11
  boolean "Qpe library (x11 enabled)"
  default "y" if X11
  default "n" if ! X11
  depends on X11
```

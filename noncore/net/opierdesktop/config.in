## noncore/net/opierdesktop/config.in
```kconfig
  config OPIE-RDESKTOP
    boolean "opie-rdesktop (rdp client)"
    default "n"
    depends ( LIBQPE || LIBQPE-X11 )
    comment "opie-rdesktop needs a libqpe"
    depends !( LIBQPE || LIBQPE-X11 )
```

## noncore/net/opiestumbler/config.in
```kconfig
  config OPIESTUMBLER
    boolean "opie-stumbler (find wireless networks)"
    default "y"
    depends ( LIBQPE || LIBQPE-X11 ) && LIBOPIE2CORE && LIBOPIE2NET && LIBOPIE2UI
```

## noncore/net/opietooth/applet/config.in
```kconfig
  config OPIETOOTH-APPLET
    boolean
    default "y"
    depends ( LIBQPE || LIBQPE-X11 ) && LIBOPIE2CORE && OPIETOOTH && LIBOPIETOOTH
```

## noncore/net/opietooth/blue-pin/config.in
```kconfig
  config BLUE-PIN
    boolean "opie-bluepin (Bluetooth pin application)"
    default "y"
    depends ( LIBQPE || LIBQPE-X11 ) && LIBOPIE2CORE && OPIETOOTH
```

## noncore/net/opietooth/lib/config.in
```kconfig
  config LIBOPIETOOTH
    boolean "libopietooth1 (Opie Bluetooth library)"
    default "y"
    depends ( LIBQPE || LIBQPE-X11 ) && LIBOPIECORE2 && OPIETOOTH
```

## noncore/net/opietooth/lib_affix/config.in
```kconfig
  config LIBOPIETOOTH_AFFIX
    boolean "libopietooth_affix"
    default "n"
    depends ( LIBQPE || LIBQPE-X11 ) && LIBOPIE && OPIETOOTH
```

## noncore/net/opietooth/lib_bluez/config.in
```kconfig
  config LIBOPIETOOTH_BLUEZ
    boolean "libopietooth_bluez"
    default "y"
    depends ( LIBQPE || LIBQPE-X11 ) && LIBOPIE && OPIETOOTH
```

## noncore/net/opietooth/lib_common/config.in
```kconfig
  config LIBOPIETOOTH_COMMON
    boolean "libopietooth_common"
    default "n"
    depends ( LIBQPE || LIBQPE-X11 ) && LIBOPIE && OPIETOOTH
```

## noncore/net/opietooth/manager/config.in
```kconfig
  config OPIETOOTH-MANAGER
    boolean "opie-bluetoothmanager (Bluetooth manager)"
    default "y"
    depends ( LIBQPE || LIBQPE-X11 ) && LIBOPIE2CORE && OPIETOOTH && LIBOPIETOOTH
```

## noncore/net/ubrowser/config.in
```kconfig
  config UBROWSER
    boolean "opie-ubrowser (a very small web brower)"
    default "n"
    depends ( LIBQPE || LIBQPE-X11 )
```

## noncore/net/wellenreiter/config.in
```kconfig
  config WELLENREITER
    boolean "opie-wellenreiter (wireless LAN monitor)"
    default "y"
    depends ( LIBQPE || LIBQPE-X11 ) && LIBOPIE2CORE && LIBOPIE2NET && LIBOPIE2UI
    comment "wellenreiter needs a libqpe and libopie2 (core+net+ui)"
    depends !(( LIBQPE || LIBQPE-X11 ) && LIBOPIE2CORE && LIBOPIE2NET && LIBOPIE2UI)
```

## noncore/securityplugins/blueping/config.in
```kconfig
  config MULTIAUTH_BLUEPING
    boolean "opie-multiauth-blueping (blueping authentication plugin)"
    default "y"
    depends SECURITY && OPIETOOTH
    comment "opie-multiauth-blueping requires Bluetooth support"
    depends !(OPIETOOTH)
```

## noncore/securityplugins/dummy/config.in
```kconfig
  config MULTIAUTH_DUMMY
    boolean "opie-multiauth-dummy (dummy authentication plugin, for testing purposes)"
    default "y"
    depends SECURITY
```

## noncore/securityplugins/notice/config.in
```kconfig
  config MULTIAUTH_NOTICE
    boolean "opie-multiauth-notice (Notice authentication plugin)"
    default "y"
    depends SECURITY
```

## noncore/securityplugins/pin/config.in
```kconfig
  config MULTIAUTH_PIN
    boolean "opie-multiauth-pin (PIN authentication plugin)"
    default "y"
    depends SECURITY
```

## noncore/settings/appearance2/config.in
```kconfig
  config APPEARANCE2
    boolean "opie-appearance (control color, widget view etc)"
    default "y"
    depends ( LIBQPE || LIBQPE-X11 ) && LIBOPIE2UI && LIBQTAUX
```

## noncore/settings/aqpkg/config.in
```kconfig
  config AQPKG
    boolean "opie-aqpkg (a package manager)"
    default "y"
    depends ( LIBQPE || LIBQPE-X11 ) && LIBOPIE2CORE && LIBOPIE2UI
```

## noncore/settings/backup/config.in
```kconfig
  config BACKUP
    boolean "opie-backup (save and restore current Opie settings)"
    default "y"
    depends ( LIBQPE || LIBQPE-X11 ) && LIBOPIE && LIBOPIE2CORE
```

## noncore/settings/doctab/config.in
```kconfig
  config DOCTAB
    boolean "opie-doctab (select doctab for Opie)"
    default "y"
    depends ( LIBQPE || LIBQPE-X11 ) && LIBOPIE2CORE
```

## noncore/settings/kbddcontrol/applet/config.in
```kconfig
  config KBDDAPPLET
    boolean "opie-kbddapplet (kbdd external keyboard control applet)"
    default "n"
    depends ( LIBQPE || LIBQPE-X11 ) && LIBOPIE2CORE && LIBOPIE2UI
```

## noncore/settings/kbddcontrol/config.in
```kconfig
  config KBDDCONTROL
    boolean "opie-kbddcontrol (kbdd external keyboard settings)"
    default "n"
    depends ( LIBQPE || LIBQPE-X11 ) && LIBOPIE2CORE && LIBOPIE2UI

  source noncore/settings/kbddcontrol/applet/config.in
```

## noncore/settings/language/config.in
```kconfig
  config LANGUAGE
    boolean "opie-language (select language for Opie)"
    default "y"
    depends ( LIBQPE || LIBQPE-X11 ) && LIBOPIE2CORE
```

## noncore/settings/mediummount/config.in
```kconfig
  config MEDIUMMOUNT
    boolean "opie-mediummount (configuration app for medium mounter)"
    default "y"
    depends ( LIBQPE || LIBQPE-X11 ) && LIBOPIE
```

## noncore/settings/netsystemtime/config.in
```kconfig
  config NETSYSTEMTIME
    boolean "opie-systemtime (clock setup tool with NTP ability)"
    default "y"
    depends ( LIBQPE || LIBQPE-X11 ) && LIBOPIE2CORE && LIBOPIE2UI
```

## noncore/settings/networksettings/config.in
```kconfig
config NETWORKSETUP
  boolean "opie-networksettings (TCP/IP network settings)"
  default "y"
  depends ( LIBQPE || LIBQPE-X11 ) && LIBOPIE2CORE && LIBOPIE2UI && LIBOPIE2NET

config NETWORKSETUP-CORE
  boolean
  default "y" if NETWORKSETUP
  depends ( LIBQPE || LIBQPE-X11 ) && LIBOPIE2CORE && LIBOPIE2UI && NETWORKSETUP && INTERFACES

  source noncore/settings/networksettings/ppp/config.in
  source noncore/settings/networksettings/wlan/config.in
  source noncore/settings/networksettings/interfaces/config.in
```

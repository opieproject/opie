## noncore/styles/flat/config.in
```kconfig
  config FLAT
    boolean "opie-style-flat (Simple, flat widget style)"
    default "y"
    depends ( LIBQPE || LIBQPE-X11 ) && LIBOPIE
```

## noncore/styles/fresh/config.in
```kconfig
  config FRESH
    boolean "opie-style-fresh (Simple widget style)"
    default "y"
    depends ( LIBQPE || LIBQPE-X11 ) && LIBOPIE
```

## noncore/styles/liquid/config.in
```kconfig
  config LIQUID
    boolean "opie-liquid (Mosfet's well known Liquid GUI style from KDE)"
    default "y"
    depends ( LIBQPE || LIBQPE-X11 ) && LIBQTAUX && LIBOPIE2CORE
```

## noncore/styles/metal/config.in
```kconfig
  config METAL
    boolean "opie-metal (Metal style)"
    default "y"
    depends ( LIBQPE || LIBQPE-X11 ) && LIBOPIE
```

## noncore/styles/phase/config.in
```kconfig
  config PHASE
    boolean "Phase Style 0.4 port"
    default "n"
    depends ( LIBQPE || LIBQPE-X11 ) 
```

## noncore/styles/theme/config.in
```kconfig
  config THEME
    boolean "opie-theme (theme support including opie-theme-luna)"
    default "y"
    depends ( LIBQPE || LIBQPE-X11 ) && LIBOPIE2CORE
```

## noncore/styles/web/config.in
```kconfig
  config WEBSTYLE
    boolean "WEB Style from KDE2"
    default "n"
    depends ( LIBQPE || LIBQPE-X11 ) 
```

## noncore/todayplugins/fortune/config.in
```kconfig
  config TODAY_FORTUNE
    boolean "opie-today-fortuneplugin (a joke a day keeps the doctor away)"
    default "y"
    depends (LIBQPE || LIBQPE-X11) && LIBOPIE2CORE && LIBOPIE2UI && LIBOPIE2PIM && TODAY
    depends TODAY
```

## noncore/todayplugins/stockticker/config.in
```kconfig
  config TODAY_STOCKTICKER
    boolean "opie-today-stocktickerplugin (stock ticker)"
    default "y"
    depends ( LIBQPE || LIBQPE-X11 ) && LIBOPIE2CORE && LIBOPIE2PIM && LIBOPIE2UI && TODAY

  source noncore/todayplugins/stockticker/stockticker/config.in
  source noncore/todayplugins/stockticker/stocktickerlib/config.in
```

## noncore/todayplugins/stockticker/stockticker/config.in
```kconfig
config TODAY_STOCKTICKERSUB
  boolean
  depends TODAY_STOCKTICKERLIB
  default "y" if TODAY_STOCKTICKER
  depends ( LIBQPE || LIBQPE-X11 ) && LIBOPIE2CORE && TODAY
```

## noncore/todayplugins/stockticker/stocktickerlib/config.in
```kconfig
config TODAY_STOCKTICKERLIB
  boolean
  default "y" if TODAY_STOCKTICKER
  depends ( LIBQPE || LIBQPE-X11 ) && LIBOPIE2CORE && LIBOPIE2UI && LIBOPIE2PIM && TODAY
```

## noncore/todayplugins/weather/config.in
```kconfig
  config TODAY_WEATHER
    boolean "opie-today-weatherplugin (current weather report)"
    default "y"
    depends (LIBQPE || LIBQPE-X11) && LIBOPIE
```

## noncore/tools/calc2/config.in
```kconfig
  config CALCULATOR2
    boolean "opie-calculator2 (A plugin based calculator)"
    default "y"
    depends ( LIBQPE || LIBQPE-X11 ) && LIBOPIE2CORE
```

## noncore/tools/calculator/config.in
```kconfig
  config CALCULATOR
    boolean "opie-calculator (A multi-function calculator with units conversion)"
    default "y"
    depends ( LIBQPE || LIBQPE-X11 ) && LIBOPIE
```

## noncore/tools/clock/config.in
```kconfig
  config CLOCK
    boolean "opie-clock (clock and stop-watch)"
    default "y"
    depends ( LIBQPE || LIBQPE-X11 ) && LIBOPIE
```

## noncore/tools/currconv/config.in
```kconfig
  config CURRCONV
    boolean "opie-currconv (Converts between different currencies)"
    default "y"
    depends ( LIBQPE || LIBQPE-X11 )
```

## noncore/tools/euroconv/config.in
```kconfig
  config EUROCONV
    boolean "opie-euroconv (Converts currencies between different european formats)"
    default "y"
    depends ( LIBQPE || LIBQPE-X11 ) && LIBOPIE
```

## noncore/tools/formatter/config.in
```kconfig
  config FORMATTER
    boolean "opie-formatter (filesystem formatting and mount app)"
    default "n"
    depends ( LIBQPE || LIBQPE-X11 ) && LIBOPIE2CORE
```

## noncore/tools/opie-sh/config.in
```kconfig
  config OPIE-SH
    boolean "opie-sh (qdialog frontend allows you to write dialogs from shell scripts)"
    default "y"
    depends ( LIBQPE || LIBQPE-X11 ) 
```

## noncore/tools/pimconverter/config.in
```kconfig
  config PIMCONVERTER
    boolean "opie- Pim Converter (converts pim data between different databases)"
    default "n"
    depends ( LIBQPE || LIBQPE-X11 ) && LIBOPIE2CORE && LIBOPIE2PIM && LIBOPIE2DB && SQL_PIM_BACKEND

    comment "The pim converter needs libqpe, libopie2core, libopie2pim, libopie2db and SQL Backend for libopie2pim"
    depends !(( LIBQPE || LIBQPE-X11 ) && LIBOPIE2CORE && LIBOPIE2PIM && LIBOPIE2DB && SQL_PIM_BACKEND )
    
```

## noncore/tools/pyquicklauncher/config.in
```kconfig
  config PYQUICKLAUNCHER
    boolean "python-quicklauncher (quicklaunch python scripts)"
    default "n"
```

## noncore/tools/remote/config.in
```kconfig
  config REMOTE
    boolean "opie-remote (remote control using irda, frontent to lirc)"
    default "y"
    depends ( LIBQPE || LIBQPE-X11 ) && LIBOPIE2CORE
```

## noncore/unsupported/config.in
```kconfig
source noncore/unsupported/filebrowser/config.in
source noncore/unsupported/gsmtool/config.in
source noncore/unsupported/mail2/config.in
source noncore/unsupported/mailit/config.in
source noncore/unsupported/oipkg/config.in
source noncore/unsupported/qpdf/config.in
source noncore/unsupported/showimg/config.in
source noncore/unsupported/tabmanager/config.in
source noncore/unsupported/ubrowser/config.in
source noncore/unsupported/usermanager/config.in
source noncore/unsupported/qws/config.in
```

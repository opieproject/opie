## noncore/games/wordgame/config.in
```kconfig
  config WORDGAME
    boolean "opie-wordgame (crossword game)"
    default "y"
    depends ( LIBQPE || LIBQPE-X11 ) && LIBOPIE
```

## noncore/games/zlines/config.in
```kconfig
  config ZLINES
    boolean "opie-zlines (move 5 balls adjacent to get rid of them)"
    default "y"
    depends ( LIBQPE || LIBQPE-X11 ) && LIBOPIE2CORE
```

## noncore/games/zsame/config.in
```kconfig
  config ZSAME
    boolean "opie-zsame (a SameGame clone)"
    default "y"
    depends ( LIBQPE || LIBQPE-X11 ) && LIBOPIE2CORE
```

## noncore/graphics/drawpad/config.in
```kconfig
  config DRAWPAD
    boolean "opie-drawpad (take simple notes or draw images)"
    default "y"
    depends ( LIBQPE || LIBQPE-X11 ) && LIBOPIE2CORE && LIBOPIE2UI && LIBQTAUX
```

## noncore/graphics/opie-eye/config.in
```kconfig
  config OPIE_EYE
    boolean "opie-eye The Image Viewer and Browser"
    default "y"
    depends on ( LIBQPE || LIBQPE-X11 ) && LIBOPIE2CORE && LIBOPIE2UI && LIBOPIE2MM
    
  source noncore/graphics/opie-eye/slave/config.in
```

## noncore/graphics/opie-eye/slave/config.in
```kconfig
  config OPIE_EYE_SLAVE
    boolean
    default "y" if OPIE_EYE
    depends on ( LIBQPE || LIBQPE-X11 ) && LIBOPIE2CORE && LIBOPIE2UI && LIBOPIE2MM
```

## noncore/multimedia/camera/config.in
```kconfig
  config CAMERA
    boolean "opie-camera (camera app to use with the Sharp CE-AG06)"
    default "n"
    depends ( LIBQPE || LIBQPE-X11 ) && LIBOPIE2CORE && LIBOPIE2UI
    comment "opie-camera needs a libqpe, libopie2core & libopie2ui"
    depends !(( LIBQPE || LIBQPE-X11 ) && LIBOPIE2CORE && LIBOPIE2UI )
```

## noncore/multimedia/camera2/config.in
```kconfig
  config CAMERA2
    boolean "opie-camera2 (camera app to use with Video4Linux)"
    default "n"
    depends ( LIBQPE || LIBQPE-X11 ) && LIBOPIE2CORE && LIBOPIE2UI
    comment "opie-camera needs a libqpe, libopie2core & libopie2ui"
    depends !(( LIBQPE || LIBQPE-X11 ) && LIBOPIE2CORE && LIBOPIE2UI )
```

## noncore/multimedia/opieplayer2/config.in
```kconfig
  config OPIEPLAYER2
    boolean "opieplayer2"
    default "n"
    depends ( LIBQPE || LIBQPE-X11 ) && LIBOPIE2CORE && LIBOPIE2UI && LIBXINE_DEP
    comment "opieplayer2 requires libopie2core, libopie2ui and libxine"
```

## noncore/multimedia/opierec/config.in
```kconfig
  config OPIEREC
    boolean "opie-rec (simple audio recording/playing app)"
    default "n"
    depends ( LIBQPE || LIBQPE-X11 ) 
```

## noncore/multimedia/powerchord/config.in
```kconfig
  config POWERCHORD
    boolean "opie-powerchord (guitar chord generator and tuning)"
    default "n"
    depends ( LIBQPE || LIBQPE-X11 ) && LIBOPIE2CORE
    comment "opie-powerchord needs a libqpe and libopiecore2"
    depends !(( LIBQPE || LIBQPE-X11 ) && LIBOPIE2CORE )
```

## noncore/multimedia/showimg/config.in
```kconfig
  config SHOWIMG
    boolean "opie-showimg (image viewer)"
    default "y"
    depends ( LIBQPE || LIBQPE-X11 ) && LIBOPIE2CORE && LIBOPIE2UI
```

## noncore/multimedia/tonleiter/config.in
```kconfig
  config TONLEITER
    boolean "tonleiter (shows scales on sting instruments)"
    default "n"
    depends ( LIBQPE || LIBQPE-X11 ) && LIBOPIE2CORE
```

## noncore/net/connman/applet/config.in
```kconfig
  config CONNMAN-APPLET
    boolean "opie-connmanapplet (Network connection manager applet)"
    default "y"
    depends ( LIBQPE || LIBQPE-X11 ) && LIBOPIE2CORE && CONNMAN
```

## noncore/net/connman/settings/config.in
```kconfig
  config CONNMAN-SETTINGS
    boolean "opie-connmansettings (Network connection manager settings)"
    default "n"
    depends ( LIBQPE || LIBQPE-X11 ) && LIBOPIE2CORE && LIBOPIE2UI && CONNMAN
```

## noncore/net/mail/config.in
```kconfig
source noncore/net/mail/libmailwrapper/config.in

config MAIL3
    boolean "opie-mail3 (a mail client)"
    default "y"
    depends ( LIBQPE || LIBQPE-X11 ) && LIBOPIE2CORE && LIBOPIE2PIM && LIBOPIE2DB && LIBMAILWRAPPER
    comment "opie-mail3 needs a libqpe, libopie2core, libopie2pim, libopie2db and the libmailwrapper"
    depends ! ( ( LIBQPE || LIBQPE-X11 ) && LIBOPIE2CORE && LIBOPIE2PIM && LIBOPIE2DB && LIBMAILWRAPPER )

source noncore/net/mail/taskbarapplet/config.in
```

## noncore/net/mail/libmailwrapper/config.in
```kconfig
 config LIBMAILWRAPPER
    boolean "libmailwrapper (libetpan wrapper library)"
    default "y"
    depends ( LIBQPE || LIBQPE-X11 )
```

## noncore/net/mail/taskbarapplet/config.in
```kconfig
 config MAILAPPLET
    boolean "mailapplet (taskbar mail applet)"
    default "y"
    depends ( LIBQPE || LIBQPE-X11 ) && LIBOPIE2CORE && LIBMAILWRAPPER
    comment "mailapplet needs a libqpe, libopie2core and the libmailwrapper"
    depends !( ( LIBQPE || LIBQPE-X11 ) && LIBOPIE2CORE && LIBMAILWRAPPER )
```

## noncore/net/networksetup/config.in
```kconfig
menu "networksetup"

  config INTERFACES
    boolean "networksetup"
    default "y"
    depends ( LIBQPE || LIBQPE-X11 ) && LIBOPIE && WLAN && INTERFACES

  source noncore/net/networksetup/wlan/config.in
  source noncore/net/networksetup/interfaces/config.in
endmenu
```

## noncore/net/networksetup/interfaces/config.in
```kconfig
  config INTERFACES
    boolean
    default "y" if NETWORKSETUP
    depends ( LIBQPE || LIBQPE-X11 ) && LIBOPIE
```

## noncore/net/networksetup/wlan/config.in
```kconfig
  config WLAN
    boolean "Wireless LAN Module"
    default "y" if NETWORKSETUP
    depends ( LIBQPE || LIBQPE-X11 ) && LIBOPIE && NETWORKSETUP && NETWORKSETUP-CORE && INTERFACES
```

## noncore/net/opie-smb/config.in
```kconfig
  config OPIESMB
    boolean "opie-smb (samba front end client for Opie)"
    default "n"
    depends ( LIBQPE || LIBQPE-X11 ) && LIBOPIE2CORE
```

## noncore/net/opieftp/config.in
```kconfig
  config OPIEFTP
    boolean "opie-ftp (ftp client for Opie)"
    default "y"
    depends ( LIBQPE || LIBQPE-X11 ) && LIBOPIE && FTPLIB
```

## noncore/net/opieirc/config.in
```kconfig
  config OPIEIRC
    boolean "opie-irc (chat via your favorite IRC server)"
    default "y"
    depends ( LIBQPE || LIBQPE-X11 ) && LIBOPIEUI2 && LIBQTAUX
```

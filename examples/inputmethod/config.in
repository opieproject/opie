## examples/inputmethod/config.in
```kconfig
  config EXAMPLE_BOARD
    boolean "Input Method Example"
    default "y"
    depends ( LIBQPE || LIBQPE-X11 ) && LIBOPIE && EXAMPLES
```

## examples/main-tab/config.in
```kconfig
  config MAIN_TAB_EXAMPLE
    boolean "Mainwindow with OTabWidget example"
    default "y"
    depends ( LIBQPE || LIBQPE-X11 ) && EXAMPLES && LIBOPIEUI2
```

## examples/menuapplet/config.in
```kconfig
  config EXAMPLE_MENU
    boolean "O-Menu Applet"
    default "y"
    depends ( LIBQPE || LIBQPE-X11 ) && LIBOPIE && EXAMPLES
```

## examples/networksettings/config.in
```kconfig
  config EXAMPLE_VPN
    boolean "opie-networksettingsplugin-example (VPN module)"
    default "n" if NETWORKSETUP
    depends ( LIBQPE || LIBQPE-X11 ) && LIBOPIE2CORE && NETWORKSETUP && NETWORKSETUP-CORE && INTERFACES && EXAMPLES
```

## examples/opiebluez/config.in
```kconfig
 config EXAMPLE_LIBOPIE2BLUEZ
    boolean "libopiebluez2 examples"
    depends ( LIBQPE || LIBQPE-X11 ) && LIBOPIE2BLUEZ && EXAMPLES
```

## examples/opiecore/config.in
```kconfig
 config EXAMPLE_LIBOPIE2CORE
    boolean "libopiecore2 examples"
    depends ( LIBQPE || LIBQPE-X11 ) && LIBOPIE2CORE
```

## examples/opiedb/config.in
```kconfig
 config EXAMPLE_LIBOPIE2DB
    boolean "libopiedb2 examples"
    depends ( LIBQPE || LIBQPE-X11 ) && LIBOPIE2DB
```

## examples/opiemm/config.in
```kconfig
 config EXAMPLE_LIBOPIE2MM
    boolean "libopiemm2 examples"
    depends ( LIBQPE || LIBQPE-X11 ) && LIBOPIE2MM
```

## examples/opienet/config.in
```kconfig
 config EXAMPLE_LIBOPIE2NET
    boolean "libopienet2 examples"
    depends ( LIBQPE || LIBQPE-X11 ) && LIBOPIE2NET && EXAMPLES
```

## examples/opieui/config.in
```kconfig
 config EXAMPLE_LIBOPIE2UI
    boolean "libopieui2 examples"
    depends ( LIBQPE || LIBQPE-X11 ) && LIBOPIE2CORE && LIBOPIE2UI && EXAMPLES
```

## examples/python/config.in
```kconfig
  config PYTHON_EXAMPLES
    boolean "Build Python Examples"
    default "n"
    depends ( LIBQPE || LIBQPE-X11 ) && EXAMPLES
```

## examples/simple-icon/config.in
```kconfig
  config SIMPLE_ICON
    boolean "Simples Widget which loads Pixmaps and plays sound"
    default "y"
    depends ( LIBQPE || LIBQPE-X11 ) && EXAMPLES
```

## examples/simple-main/config.in
```kconfig
  config SIMPLE_MAIN
    boolean "Simple Mainwindow with Actions buttons and iconsets"
    default "y"
    depends ( LIBQPE || LIBQPE-X11 ) && LIBOPIE2CORE && EXAMPLES
```

## examples/simple-pim/config.in
```kconfig
  config SIMPLE_PIM
    boolean "Mainwindow with PIM and QCOP usage"
    default "y"
    depends ( LIBQPE || LIBQPE-X11 ) && EXAMPLES && LIBOPIE2CORE && LIBOPIE2UI && LIBOPIE2PIM
```

## examples/simple/config.in
```kconfig
  config SIMPLE_EXAMPLE
    boolean "Simple widget with a button"
    default "y"
    depends ( LIBQPE || LIBQPE-X11 ) && EXAMPLES
```

## examples/todayplugin/config.in
```kconfig
  config TODAY_EXAMPLE
    boolean "Opie-Today Plugin Example"
    default "n"
    depends ( LIBQPE || LIBQPE-X11 ) && EXAMPLES && LIBOPIE
```

## freetype/config.in
```kconfig
  config FREETYPE
    boolean "opie-freetype (support for fonts used via the freetype library)"
    default "y"
    depends ( LIBQPE || LIBQPE-X11 ) && LIBOPIE2CORE
```

## inputmethods/dasher/config.in
```kconfig
  config DASHER
    boolean "opie-dasher (zooming predictive text input)"
    default "y"
    depends ( LIBQPE || LIBQPE-X11 )
```

## inputmethods/dvorak/config.in
```kconfig
  config DVORAK
    boolean "opie-dvorak (keyboard in DVORAK layout)"
    default "y"
    depends ( LIBQPE || LIBQPE-X11 ) && LIBOPIE && PICKBOARD
  comment "opie-dvorak needs opie-pickboard"
    depends !(( LIBQPE || LIBQPE-X11 ) && LIBOPIE && PICKBOARD)
```

## inputmethods/handwriting/config.in
```kconfig
  config HANDWRITING
    boolean "opie-handwriting (Handwriting recognition)"
    default "y"
    depends ( LIBQPE || LIBQPE-X11 ) && LIBOPIE2CORE
  comment "opie-handwriting-classicset automatically selected"
    depends HANDWRITING
  comment "opie-handwriting-graffitiset automatically selected"
    depends HANDWRITING
```

## inputmethods/jumpx/config.in
```kconfig
  config JUMPX
    boolean "opie-jumpx (keyboard optimized for single finger/stylus input)"
    default "y"
    depends ( LIBQPE || LIBQPE-X11 ) 
```

## inputmethods/keyboard/config.in
```kconfig
  config KEYBOARD
    boolean "opie-keyboard (keyboard in QWERTY layout)"
    default "y"
    depends ( LIBQPE || LIBQPE-X11 ) && PICKBOARD
  comment "opie-keyboard needs opie-pickboard"
    depends !(( LIBQPE || LIBQPE-X11 ) && PICKBOARD)
```

## inputmethods/kjumpx/config.in
```kconfig
  config KJUMPX
    boolean "opie-kjumpx (korean keyboard optimized for single finger/stylus input)"
    default "y"
    depends ( LIBQPE || LIBQPE-X11 ) 
```

## inputmethods/multikey/config.in
```kconfig
  config MULTIKEY
    boolean "opie-multikey (OnScreen keyboard for multiple languages)"
    default "y"
    depends ( LIBQPE || LIBQPE-X11 ) && PICKBOARD && LIBQTAUX && LIBOPIE2UI
```

## inputmethods/pickboard/config.in
```kconfig
  config PICKBOARD
    boolean "opie-pickboard (lets you dictionary-based pick whole words based on partial input)"
    default "y"
    depends ( LIBQPE || LIBQPE-X11 ) && LIBOPIE
```

## core/pim/datebook2/plugins/config.in
```kconfig
menu "Holiday Plugins2"
  source core/pim/datebook2/plugins/birthday/config.in
  source core/pim/datebook2/plugins/christian/config.in
  source core/pim/datebook2/plugins/national/config.in
endmenu
```

## core/pim/datebook2/plugins/national/config.in
```kconfig
  config DATEBOOK2_NATIONAL_HOLIDAY
    boolean "opie-datebook2-national-holidays"
    default "y"
    depends ( LIBQPE || LIBQPE-X11 ) && LIBOPIE2CORE && LIBOPIE2UI && LIBOPIE2PIM
```

## core/pim/notes/config.in
```kconfig
  config NOTES
    boolean "opie-notes (a simple note taking application)"
    default "y"
    depends ( LIBQPE || LIBQPE-X11 ) && LIBOPIE2CORE && LIBOPIE2UI && LIBOPIE2PIM
```

## core/pim/osearch/config.in
```kconfig
  config OSEARCH
    boolean "opie-osearch (searches throught your PDA)"
    default "y"
    depends ( LIBQPE || LIBQPE-X11 ) && LIBOPIE2CORE && LIBOPIE2UI && LIBOPIE2PIM
```

## core/pim/today/config.in
```kconfig
  config TODAY
    boolean "opie-today (today gives an overview of appointments and todos)"
    default "y"
    depends ( LIBQPE || LIBQPE-X11 ) && LIBOPIE2CORE && LIBOPIE2UI && LIBOPIE2PIM
```

## core/pim/today/plugins/addressbook/config.in
```kconfig
  config TODAY_ADDRESSBOOK
    boolean "opie-today-addressbookplugin (shows Birthdays and Anniversaries)"
    default "y"
    depends ( LIBQPE || LIBQPE-X11 ) && LIBOPIE2CORE && LIBOPIE2UI && LIBOPIE2PIM && LIBQTAUX

    comment "opie-today-addressbookplugin requires libopie2core, libopie2ui, libopie2pim, libopie2db and libqtaux"
    depends !( ( LIBQPE || LIBQPE-X11 ) && LIBOPIE2CORE && LIBOPIE2UI && LIBOPIE2PIM && LIBQTAUX )
```

## core/pim/today/plugins/datebook/config.in
```kconfig
  config TODAY_DATEBOOK
    boolean "opie-today-datebookplugin"
    default "y"
    depends ( LIBQPE || LIBQPE-X11 ) && LIBOPIE2UI && LIBOPIE2CORE && LIBOPIE2PIM

    comment "opie-today-datebookplugin requires libopie2ui and libopie2core"
    depends !( LIBQPE || LIBQPE-X11 ) && LIBOPIE2UI && LIBOPIE2CORE && LIBOPIE2PIM
```

## core/pim/today/plugins/mail/config.in
```kconfig
  config TODAY_MAIL
    boolean "opie-today-mailplugin"
    default "y"
    depends ( LIBQPE || LIBQPE-X11 ) && LIBOPIE2CORE && LIBOPIE2PIM && LIBMAILWRAPPER

    comment "opie-today-mailplugin requires libopie2core, libopie2pim, and libmailwrapper"
    depends !( ( LIBQPE || LIBQPE-X11 ) && LIBOPIE2CORE && LIBOPIE2PIM && LIBMAILWRAPPER )
```

## core/pim/today/plugins/todolist/config.in
```kconfig
  config TODAY_TODOLIST
    boolean "opie-today-todolistplugin"
    default "y"
    depends ( LIBQPE || LIBQPE-X11 ) && LIBOPIE2CORE && LIBOPIE2UI && LIBOPIE2PIM

    comment "opie-today-todolistplugin requires libopie2core, libopie2ui, libopie2pim"
    depends !( ( LIBQPE || LIBQPE-X11 ) && LIBOPIE2CORE && LIBOPIE2UI && LIBOPIE2PIM )
```

## core/pim/todo/config.in
```kconfig
  config TODO
    boolean "opie-todo (a Todo-list manager)"
    default "y"
    depends ( LIBQPE || LIBQPE-X11 ) && LIBOPIE2CORE && LIBOPIE2UI && LIBOPIE2PIM
```

## core/qws/config.in
```kconfig
  config QWS
    boolean "Minimal QWS Server"
    default "n"
    depends ( LIBQPE || LIBQPE-X11 ) && LIBOPIE

# menu "Advanced QWS Server Config"
#   config QWS_QCOP
#     bool "QCop bridge and Transfer server (sync)"
#     default y
#     depends on QWS
#
#   config QWS_PACKAGE
#     bool "Package Slave (package installs via sync software)"
#     default n
#     depends on QWS
# endmenu
```

## core/server/config.in
```kconfig
  config SERVER
    boolean "Server"
    default "y"
    depends ( LIBQPE || LIBQPE-X11 ) && LIBOPIE

if SERVER
  config PRELOAD
    boolean
    default "y"
    depends ( LIBQPE || LIBQPE-X11 ) && LIBOPIE && SERVER

  config SERVER
    boolean
    default "y"
    depends ( LIBQPE || LIBQPE-X11 ) && LIBOPIE && SERVER && PRELOAD
endif
```

## core/settings/button/config.in
```kconfig
  config BUTTON-SETTINGS
    boolean "opie-button-settings (application buttons settings)"
    default "y"
    depends ( LIBQPE || LIBQPE-X11 ) && LIBOPIE2CORE && !TARGET_RAMSES
```

## core/settings/citytime/config.in
```kconfig
  config CITYTIME
    boolean "opie-citytime (Time-zone / world clock settings)"
    default "y"
    depends ( LIBQPE || LIBQPE-X11 ) && LIBOPIE2CORE
```

## core/settings/launcher/config.in
```kconfig
  config LAUNCHER-SETTINGS
    boolean "opie-launcher-settings (Opie taskbar settings)"
    default "y"
    depends ( LIBQPE || LIBQPE-X11 ) && LIBOPIEUI2 &&  LIBQTAUX
```

## core/settings/light-and-power/config.in
```kconfig
  config LIGHT-AND-POWER
    boolean "opie-light-and-power (apm and energy saving settings)"
    default "y"
    depends ( LIBQPE || LIBQPE-X11 ) && LIBOPIE2CORE
```

## core/settings/security/config.in
```kconfig
  config SECURITY
    boolean "opie-security (to set any kind of PDA usage protection)"
    default "y"
    depends ( LIBQPE || LIBQPE-X11 ) && LIBOPIE2CORE && LIBOPIE2UI

  source core/settings/security/demo/config.in
```

## core/settings/security/demo/config.in
```kconfig
  config MULTIAUTH_DEMO
    boolean "opie-security multiauth demo (small app only used for testing security plugins & framework)"
    default "n"
    depends SECURITY
```

## core/symlinker/config.in
```kconfig
  config SYMLINKER
    boolean "Opie Symlinker for external media"
    default "y"
    depends ( LIBQPE || LIBQPE-X11 ) && LIBOPIE2CORE
    comment "Opie Symlinker needs a libqpe"
    depends !( LIBQPE || LIBQPE-X11 )
```

## core/tools/hotplug-qcop/config.in
```kconfig
  config HOTPLUG_QCOP
    boolean "The HotPlug -> QCop Event Bridge"
    default "y"
    depends ( LIBQPE || LIBQPE-X11 )
```

## core/tools/quicklauncher/config.in
```kconfig
  config QUICKLAUNCHER
    boolean "The Quick Launcher Loader"
    default "y"
    depends ( LIBQPE || LIBQPE-X11 ) && LIBOPIEUI2 && LIBOPIECORE2
```

## development/keyview/config.in
```kconfig
  config KEYVIEW
    boolean "opie-keyview (Debugging 'inputmethod' for viewing keypresses)"
    default "y"
    depends ( LIBQPE || LIBQPE-X11 )
```

## examples/applet/config.in
```kconfig
  config APPLET_EXAMPLE
    boolean "Taskbar Applet Example"
    default "y"
    depends ( LIBQPE || LIBQPE-X11 ) && LIBOPIE2CORE && LIBOPIE2UI && EXAMPLES 
```

## examples/config.in
```kconfig
  source examples/applet/config.in
  source examples/inputmethod/config.in
  source examples/main-tab/config.in
  source examples/menuapplet/config.in
  source examples/networksettings/config.in
  source examples/python/config.in
  source examples/simple/config.in
  source examples/simple-icon/config.in
  source examples/simple-main/config.in
  source examples/simple-pim/config.in
  source examples/todayplugin/config.in
```

## core/apps/qss/config.in
```kconfig
  config QSS
    boolean "A Sound Server for Qt 2.3.x where x >= 10 (qss)"
    default "n"
    depends ( LIBQPE || LIBQPE-X11 ) 
```

## core/apps/taboapp/config.in
```kconfig
  config TABOAPP
    boolean "taboapp"
    default "n"
    depends ( LIBQPE || LIBQPE-X11 ) && LIBOPIE2UI && OAPP && EXPERIMENTAL
```

## core/apps/textedit/config.in
```kconfig
  config TEXTEDIT
    boolean "opie-textedit (simple text editor)"
    default "y"
    depends ( LIBQPE || LIBQPE-X11 ) && LIBOPIE2CORE && LIBOPIE2UI
```

## core/launcher/config.in
```kconfig
  config LAUNCHER
    boolean "Opie-taskbar (program launcher qpe for Opie) "
    default "y"
    depends ( LIBQPE || LIBQPE-X11 ) && LIBOPIE2CORE && LIBOPIE2UI && LIBOPIE2SECURITY && LIBQRSYNC
    comment "Launcher needs a libqpe, libopie2core, libopiei2ui, libiopie2security and libqrsync"
    depends !(( LIBQPE || LIBQPE-X11 ) && LIBOPIE2CORE && LIBOPIE2UI && LIBOPIE2SECURITY && LIBQRSYNC)

  config LAUNCHER_SYNC_V2
    boolean "  Support for PIM sync v2 protocol"
    default "y"
    depends LAUNCHER && LIBOPIE2PIM && LIBOPIE2DB
```

## core/launcher/libpreload/config.in
```kconfig
config LIBPRELOAD
  boolean "Preload library"
  default "y" if ! X11
  default "n" if X11
  depends on ! X11
```

## core/multimedia/opieplayer/config.in
```kconfig
  config OPIEPLAYER
    boolean "opie-mediaplayer (mediaplayer that plays mp3, mpeg, and wav)"
    default "y"
    depends ( LIBQPE || LIBQPE-X11 ) && LIBOPIEUI2

  source core/multimedia/opieplayer/libflash/config.in
  source core/multimedia/opieplayer/libmad/config.in
  source core/multimedia/opieplayer/libmpeg3/config.in
  source core/multimedia/opieplayer/modplug/config.in
  source core/multimedia/opieplayer/wavplugin/config.in
  source core/multimedia/opieplayer/vorbis/tremor/config.in
  source core/multimedia/opieplayer/vorbis/config.in
```

## core/multimedia/opieplayer/libmad/config.in
```kconfig
  config LIBMAD
    boolean "opieplayer1-libmadplugin (plugin with shoutcast/icecast support to play MP3 files)"
    default "y"
    depends ( LIBQPE || LIBQPE-X11 ) && LIBOPIE && OPIEPLAYER
```

## core/multimedia/opieplayer/libmpeg3/config.in
```kconfig
  config LIBMPEG3
    boolean "opieplayer1-libmpeg3plugin (play MPEG3 video files)"
    default "y"
    depends ( LIBQPE || LIBQPE-X11 ) && LIBOPIE && OPIEPLAYER
```

## core/multimedia/opieplayer/modplug/config.in
```kconfig
  config MODPLUG
    boolean "opieplayer1-modplugin (play MOD/XM/S3M/IT amiga tracker modules)"
    default "y"
    depends ( LIBQPE || LIBQPE-X11 ) && LIBOPIE && OPIEPLAYER
```

## core/multimedia/opieplayer/vorbis/config.in
```kconfig
  config LIBTREMORPLUGIN
    boolean "opieplayer1-libtremorplugin (play OGG vorbis files)"
    default "y"
    depends ( LIBQPE || LIBQPE-X11 ) && OPIEPLAYER
    
```

## core/multimedia/opieplayer/vorbis/tremor/config.in
```kconfig
  config LIBTREMOR
    boolean "libtremor (library needed to play OGG files)"
    default "y"
    depends ( LIBQPE || LIBQPE-X11 ) && OPIEPLAYER
```

## core/multimedia/opieplayer/wavplugin/config.in
```kconfig
  config WAVPLUGIN
    boolean "opieplayer1-wavplugin (play WAV files)"
    default "y"
    depends ( LIBQPE || LIBQPE-X11 ) && LIBOPIE && OPIEPLAYER
```

## core/obex/config.in
```kconfig
  config OBEX
    boolean "libopieobex0 (library needed for beaming in Opie)"
    default "y"
    depends ( LIBQPE || LIBQPE-X11 ) && LIBOPIE2CORE
```

## core/opie-login/config.in
```kconfig
  config OPIE-LOGIN
    boolean "opie-login (Initial Login app, ala xdm/kdm/gdm)"
    default "y"
    depends ( LIBQPE || LIBQPE-X11 ) && LIBOPIE2CORE

config OPIELOGIN_USEPAM
    boolean "Compile login manager with PAM support"
    depends OPIE-LOGIN
```

## core/opiealarm/config.in
```kconfig
config OPIEALARM
  boolean "opie-opiealarm (Alarm daemon, sets RTC with wakeup time on suspend)"
  depends ! TARGET_X86
  default "y"
```

## core/pim/addressbook/config.in
```kconfig
  config ADDRESSBOOK
    boolean "opie-addressbook (a simple addressbook)"
    default "y"
    depends ( LIBQPE || LIBQPE-X11 ) && LIBOPIE2CORE && LIBOPIE2UI && LIBOPIE2PIM
```

## core/pim/datebook/config.in
```kconfig
  config DATEBOOK
    boolean "opie-datebook (a datebook/appointment manager)"
    default "n"
    depends ( LIBQPE || LIBQPE-X11 ) && LIBOPIE2CORE && LIBOPIE2UI && LIBOPIE2PIM
```

## core/pim/datebook/holiday/christian/config.in
```kconfig
  config DATEBOOK_CHRISTIAN_HOLIDAY
    boolean "opie-datebook-christian-holidays"
    default "y"
    depends ( LIBQPE || LIBQPE-X11 ) && LIBOPIE2CORE && LIBOPIE2UI && LIBOPIE2PIM
```

## core/pim/datebook/holiday/config.in
```kconfig
menu "Holiday Plugins"
  source core/pim/datebook/holiday/birthday/config.in
  source core/pim/datebook/holiday/christian/config.in
  source core/pim/datebook/holiday/dummy/config.in
endmenu
```

## core/pim/datebook/holiday/dummy/config.in
```kconfig
  config DATEBOOK_DUMMY_HOLIDAY
    boolean "opie-datebook-dummy-holidays"
    default "n"
    depends ( LIBQPE || LIBQPE-X11 ) && LIBOPIE2CORE && LIBOPIE2UI && LIBOPIE2PIM
```

## core/pim/datebook/plugins/christian/config.in
```kconfig
  config DATEBOOK_CHRISTIAN_PLUGIN
    boolean "opie-datebook-christian-holidays"
    default "y"
    depends ( LIBQPE || LIBQPE-X11 ) && LIBOPIE2CORE && LIBOPIE2UI && LIBOPIE2PIM
```

## core/pim/datebook/plugins/config.in
```kconfig
menu "Holiday Plugins"
  source core/pim/datebook/plugins/birthday/config.in
  source core/pim/datebook/plugins/christian/config.in
  source core/pim/datebook/plugins/national/config.in
endmenu
```

## core/pim/datebook2/plugins/birthday/config.in
```kconfig
  config DATEBOOK2_BIRTHDAYS_PLUGIN
    boolean "opie-datebook2-birthdays"
    default "y"
    depends ( LIBQPE || LIBQPE-X11 ) && LIBOPIE2CORE && LIBOPIE2UI && LIBOPIE2PIM
```

## core/pim/datebook2/plugins/christian/config.in
```kconfig
  config DATEBOOK2_CHRISTIAN_PLUGIN
    boolean "opie-datebook2-christian-holidays"
    default "y"
    depends ( LIBQPE || LIBQPE-X11 ) && LIBOPIE2CORE && LIBOPIE2UI && LIBOPIE2PIM
```

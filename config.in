## config.in
```kconfig
mainmenu "Opie Configuration"

menu "Build Parameters"

choice
  prompt "Target Machine"
  default TARGET_X86
  help
    Please select the architecture of the machine you will be
    building the OpenZaurus buildroot for.

  config TARGET_X86
    boolean "Intel X86"

  config TARGET_MACOSX
    boolean "Mac OS X (DARWIN)"

  config TARGET_SHARP
    boolean "Sharp Zaurus w/ SA1100 (5000 and 5500)"

  config TARGET_C700
    boolean "Sharp Zaurus w/ PXA25x (5600, C7x0, C8x0)"

  config TARGET_IPAQ
    boolean "iPAQ"

  config TARGET_RAMSES
    boolean "Ramses"

  config TARGET_SIMPAD
    boolean "SIMpad"

  config TARGET_YOPY
    boolean "Yopy 3500/3700"  

endchoice

config OPTIMIZE
  boolean "Use optimizations"
  default "y" if ! TARGET_X86

# added for threaded compile
config THREADED
  boolean "Enable threaded build"
  default "n"

config DEBUG
  boolean "Enable debug builds"
  default n
config RELEASE
  bool
  default y
  depends !DEBUG
  
config QUICK_LAUNCH
  boolean "Enable Quick Launch"
  default n if TARGET_X86
  default y if ! TARGET_X86
  
config QUICKLAUNCH_PATH
  string "Path to quicklauncher"
  default "./quicklauncher" if TARGET_X86
  default "/opt/QtPalmtop/bin/quicklauncher" if ! TARGET_X86

config SPECFILE
  string
  default "qws/linux-generic-g++" if TARGET_X86 && (! X11)
  default "linux-g++" if TARGET_X86 && X11
  default "qws/linux-sharp-g++" if TARGET_SHARP && (! X11)
  default "linux-g++" if TARGET_SHARP && X11
  default "qws/linux-ipaq-g++" if TARGET_IPAQ && (! X11)
  default "linux-g++" if TARGET_IPAQ && X11
  default "qws/linux-ramses-g++" if TARGET_RAMSES && (! X11)
  default "linux-g++" if TARGET_RAMSES && X11
  default "qws/linux-simpad-g++" if TARGET_SIMPAD && (! X11)
  default "linux-g++" if TARGET_SIMPAD && X11
  default "qws/linux-yopy-g++" if TARGET_YOPY && (! X11)
  default "qws/macx-generic-g++" if TARGET_MACOSX && (! X11)

config CUSTOMFILE
  string
  default "custom-ipaq.h" if TARGET_IPAQ
  default "custom-sharp.h" if TARGET_SHARP
  default "custom-ramses.h" if TARGET_RAMSES
  default "custom-ipaq.h" if TARGET_SIMPAD
  default "custom-yopy.h" if TARGET_YOPY

config OPTIMIZATIONS
  string "Optimization flags"
  depends OPTIMIZE
  default "-march=armv4 -mtune=strongarm1100 -mapcs-32 -fexpensive-optimizations -fomit-frame-pointer -O2" if TARGET_IPAQ
  default "-march=armv4 -mtune=strongarm1100 -mapcs-32 -fexpensive-optimizations -fomit-frame-pointer -O2" if TARGET_YOPY
  default "-march=armv4 -mtune=strongarm1100 -mapcs-32 -fexpensive-optimizations -fomit-frame-pointer -O2" if TARGET_SHARP
  default "-march=armv4 -mtune=strongarm1100 -mapcs-32 -fexpensive-optimizations -fomit-frame-pointer -O2" if TARGET_RAMSES
  default "-march=armv4 -mtune=strongarm1100 -mapcs-32 -fexpensive-optimizations -fomit-frame-pointer -O2" if TARGET_SIMPAD
  default "-march=armv5te -mtune=xscale -mapcs-32 -fexpensive-optimizations -fomit-frame-pointer -O2" if TARGET_C700

config EXPERIMENTAL
  bool "Prompt for development and/or incomplete items"
  default y

endmenu

menu "Configuration"
config OPIE_NO_OVERRIDE_QT
  boolean "Build Opie against an unpatched version of Qt"
  default n

config OPIE_NO_ERASERECT_FIX
  boolean "Disable Fixup eraseRect for HancomMobileWord,neocal.. to make libopiecore work on Sharps libqpe"
  default n

config OPIE_NO_BUILTIN_SHUTDOWN
  boolean "Disable the built in shutdown application"
  default y

config OPIE_NO_BUILTIN_CALIBRATE
  boolean "Disable the built in calibrate application"
  default y if TARGET_YOPY
  default n if ! TARGET_YOPY

config OPIE_SOUND_FRAGMENT_SHIFT
  string  "The sound fragment used in Opie Player I"
  default "14" if TARGET_IPAQ
  default "16" if ! TARGET_IPAQ

config USE_REALTIME_AUDIO_THREAD
  boolean "Use a realtime thread in Opie Player I"
  default y if TARGET_IPAQ || TARGET_SIMPAD || TARGET_RAMSES || TARGET_SHARP
  default n if ! (TARGET_IPAQ || TARGET_SIMPAD || TARGET_RAMSES || TARGET_SHARP)

config QT_QWS_ALLOW_OVERCLOCK
  boolean "Allow the user to overclock the device"
  depends TARGET_RAMSES
  default n

config OPIE_HIGH_RES_SMALL_PHY
  boolean "Resolution is bigger than physical screen"
  default y if TARGET_C700
  default n if ! TARGET_C700

config USE_FILE_NOTIFICATION
  boolean "Substitute (some) polling interfaces with OFileNotifier"
  default y

config OPIE_NEW_ALLOC
  boolean "Use malloc and free for the implementation"
  default y if TARGET_RAMSES || TARGET_IPAQ || TARGET_SIMPAD || TARGET_SHARP
  default n if ! (TARGET_IPAQ || TARGET_SIMPAD || TARGET_RAMSES || TARGET_SHARP)

config OPIE_NO_SOUND_PCM_READ_BITS
  boolean "There is not a pcm_read_bits io control"
  default y if TARGET_SHARP
  default n if ! TARGET_SHARP
endmenu

menu "Dependencies"
    source dependencies.in
endmenu

menu "Base"
  choice
    prompt "Qpe Library Selection"
    default LIBQPE
    source library/config.in
    source x11/config.in
  endchoice
  source libopie/config.in

  source libopie2/config.in
  source libqtaux/config.in
  source rsync/config.in
  source core/opie-login/config.in
  source core/opiealarm/config.in
  source core/tools/quicklauncher/config.in
  source core/launcher/config.in
  source core/symlinker/config.in
endmenu

comment ""

menu "Applets"
  source core/applets/config.in
  source noncore/applets/config.in
endmenu

menu "Apps"
  source core/apps/config.in
  source noncore/apps/config.in
endmenu

menu "Communications and Networking"
  source noncore/comm/config.in
  source noncore/net/config.in
endmenu

menu "Games"
  source noncore/games/config.in
endmenu

menu "Graphics and Multimedia"
  source freetype/config.in
  source noncore/graphics/config.in
  source core/multimedia/config.in
  source noncore/multimedia/config.in
endmenu

menu "Input methods"
  source inputmethods/config.in
endmenu

menu "Pim"
  source core/pim/config.in
  comment "Today Plugins ---"
    source noncore/todayplugins/config.in
    source core/pim/today/plugins/config.in
endmenu

menu "Settings"
  source core/settings/config.in
  source noncore/settings/config.in
endmenu

menu "Theming"
  comment "Decorations ---"
  source noncore/decorations/config.in
  comment "Styles ---"
  source noncore/styles/config.in
endmenu

menu "Tools"
  source noncore/tools/config.in
endmenu

menu "Development"
  source development/keyview/config.in
  #source development/debugviewer/config.in
endmenu

menu "Examples"
    config EXAMPLES
	boolean "Compile Example Application"
    source examples/config.in
endmenu

comment ""

menu "Unsupported / Unmaintained"
  source noncore/unsupported/config.in
endmenu

comment ""
  depends on EXPERIMENTAL
menu "Experimental"
  depends on EXPERIMENTAL
  source libslcompat/config.in
  source core/qws/config.in
endmenu
```

## core/applets/aboutapplet/config.in
```kconfig
  config ABOUTAPPLET
    boolean "About (show version and credits)"
    default "y"
    depends ( LIBQPE || LIBQPE-X11 )
```

## core/applets/batteryapplet/config.in
```kconfig
  config BATTERYAPPLET
    boolean "opie-batteryapplet (Applet to monitor battery status)"
    default "y"
    depends ( LIBQPE || LIBQPE-X11 ) && LIBOPIE 
```

## core/applets/cardmon/config.in
```kconfig
  config CARDMON
    boolean "opie-cardmon (monitor cf/sd/mmc card status, and eject function)"
    default "y"
    depends ( LIBQPE || LIBQPE-X11 ) && LIBOPIE2CORE
```

## core/applets/clipboardapplet/config.in
```kconfig
  config CLIPBOARDAPPLET
    boolean "opie-clipboardapplet (copy/cut/paste applet)"
    default "y"
    depends ( LIBQPE || LIBQPE-X11 ) && LIBOPIE
```

## core/applets/clockapplet/config.in
```kconfig
  config CLOCKAPPLET
    boolean "opie-clockapplet (Digital clock applet)"
    default "y"
    depends ( LIBQPE || LIBQPE-X11 ) && LIBOPIE
```

## core/applets/homeapplet/config.in
```kconfig
  config HOMEAPPLET
    boolean "Home"
    default "y"
    depends ( LIBQPE || LIBQPE-X11 ) 
```

## core/applets/irdaapplet/config.in
```kconfig
  config IRDAAPPLET
    boolean "opie-irdaapplet (applet for IR beaming/discovery)"
    default "y"
    depends ( LIBQPE || LIBQPE-X11 ) 
```

## core/applets/lockapplet/config.in
```kconfig
  config LOCKAPPLET
    boolean "opie-lockapplet (button in the Opie menu to lock the PDA)"
    default "y"
    depends ( LIBQPE || LIBQPE-X11 ) && LIBOPIE2CORE && LIBOPIE2SECURITY
```

## core/applets/logoutapplet/config.in
```kconfig
  config LOGOUTAPPLET
    boolean "Logout"
    default "y"
    depends ( LIBQPE || LIBQPE-X11 ) && LIBOPIE
```

## core/applets/multikeyapplet/config.in
```kconfig
  config MULTIKEYAPPLET
    boolean "opie-multikeyapplet (Applet to switch OnScreen keyboard layout)"
    default "y"
    depends ( LIBQPE || LIBQPE-X11 ) && MULTIKEY
```

## core/applets/obex/config.in
```kconfig
  config OBEXAPPLET
    boolean "Obex"
    default "y"
    depends ( LIBQPE || LIBQPE-X11 ) && LIBOPIE
```

## core/applets/restartapplet/config.in
```kconfig
  config RESTARTAPPLET
    boolean "opie-restartapplet (Restart Opie via taskbar)"
    default "y"
    depends ( LIBQPE || LIBQPE-X11 ) && LIBOPIE
```

## core/applets/restartapplet2/config.in
```kconfig
  config RESTARTAPPLET2
    boolean "opie-restartapplet (Restart Opie via taskbar)"
    default "y"
    depends ( LIBQPE || LIBQPE-X11 ) 
```

## core/applets/rotateapplet/config.in
```kconfig
  config ROTATEAPPLET
    boolean "Rotate"
    default "y"
    depends ( LIBQPE || LIBQPE-X11 ) && LIBOPIE
```

## core/applets/screenshotapplet/config.in
```kconfig
  config SCREENSHOTAPPLET
    boolean "opie-screenshotapplet (create images from your current display)"
    default "y"
    depends ( LIBQPE || LIBQPE-X11 ) 
```

## core/applets/suspendapplet/config.in
```kconfig
  config SUSPENDAPPLET
    boolean "Suspend"
    default "y"
    depends ( LIBQPE || LIBQPE-X11 ) && LIBOPIE
```

## core/applets/vmemo/config.in
```kconfig
  config VMEMO
    boolean "opie-vmemo (take voice memos)"
    default "y"
    depends ( LIBQPE || LIBQPE-X11 ) 
```

## core/applets/volumeapplet/config.in
```kconfig
  config VOLUMEAPPLET
    boolean "opie-volumeapplet (set volume for microphone and speaker)"
    default "y"
    depends ( LIBQPE || LIBQPE-X11 ) && LIBOPIE2CORE
```

## core/applets/vtapplet/config.in
```kconfig
  config VTAPPLET
    boolean "VT (switch to another virtual terminal)"
    default "y"
    depends ( LIBQPE || LIBQPE-X11 ) && LIBOPIE
```

## core/apps/calibrate/config.in
```kconfig
  config CALIBRATE
    boolean "opie-calibrate (standalone calibration utility)"
    default "n"
    depends ( LIBQPE || LIBQPE-X11 )
```

## core/apps/embeddedkonsole/config.in
```kconfig
  config EMBEDDEDKONSOLE
    boolean "opie-embeddedkonsole (konsole from KDE adapted for Qt/Embedded)"
    default "y"
    depends ( LIBQPE || LIBQPE-X11 ) && LIBOPIE
```

## core/apps/helpbrowser/config.in
```kconfig
  config HELPBROWSER
    boolean "opie-helpbrowser (display html help files)"
    default "y"
    depends ( LIBQPE || LIBQPE-X11 ) && LIBOPIE
```

## core/apps/oapp/config.in
```kconfig
  config OAPP
    boolean "oapp"
    default "n"
    depends ( LIBQPE || LIBQPE-X11 ) && EXPERIMENTAL
```

## core/apps/qcop/config.in
```kconfig
  config QCOP
    boolean "opie-qcop (inter-application communication client)"
    default "y"
    depends ( LIBQPE || LIBQPE-X11 ) 
```

## inputmethods/unikeyboard/config.in
```kconfig
  config UNIKEYBOARD
    boolean "opie-unikeyboard (basic method to enter arbitrary unicode characters)"
    default "y"
    depends ( LIBQPE || LIBQPE-X11 ) && LIBOPIE
```

## libdbus-qt2/config.in
```kconfig
  config LIBDBUSQT2
    boolean "DBus bindings for Qt/Embedded 2.x"
    default "y"
```

## libopie/config.in
```kconfig
  config LIBOPIE
    boolean "libopie1 (compatibility only, use libopie2* for new applications)"
    default "n"
    depends ( LIBQPE || LIBQPE-X11 )
```

## libopie2/config.in
```kconfig
menu "libopie2"
  source libopie2/opiecore/config.in
  source libopie2/opiedb/config.in
  source libopie2/opienet/config.in
  source libopie2/opiepim/config.in
  source libopie2/opieui/config.in
  source libopie2/opiemm/config.in
  comment ""
  source libopie2/examples/config.in
endmenu
```

## libopie2/examples/config.in
```kconfig
  config LIBOPIE2EXAMPLES
    boolean "libopie2 examples"
    default "n"
    depends ( LIBQPE || LIBQPE-X11 ) && LIBOPIE2CORE && LIBOPIE2DB && LIBOPIE2NET && LIBOPIE2UI && LIBOPIE2PIM && LIBOPIE2UI && LIBOPIE2MM
    comment "the examples need a libqpe, libopie2core, libopie2db, libopie2net, libopie2pim, libopie2ui and libopie2mm"
    depends !(( LIBQPE || LIBQPE-X11 ) && LIBOPIE2CORE && LIBOPIE2DB && LIBOPIE2NET && LIBOPIE2UI && LIBOPIE2PIM && LIBOPIE2UI && LIBOPIE2MM)
```

## libopie2/opiebluez/config.in
```kconfig
  config LIBOPIE2BLUEZ
    boolean "libopie2bluez (Linux Bluetooth subsystem BlueZ related classes)"
    default "y"
    depends ( LIBQPE || LIBQPE-X11 ) && LIBOPIE2CORE && LIBDBUSQT2
    comment "libopie2bluez needs a libqpe, libopie2core and Qt2 DBus bindings"
    depends !(( LIBQPE || LIBQPE-X11 ) && LIBOPIE2CORE && LIBDBUSQT2)
```

## libopie2/opiecore/config.in
```kconfig
  config LIBOPIE2CORE
    boolean "libopie2core (application, configuration and debug related classes)"
    default "n"
    depends ( LIBQPE || LIBQPE-X11 )
    comment "libopie2core needs a libqpe (yet)"
    depends !( LIBQPE || LIBQPE-X11 )
```

## libopie2/opiedb/config.in
```kconfig
  config LIBOPIE2DB
    boolean "libopie2db (database related classes)"
    default "y"
    depends ( LIBQPE || LIBQPE-X11 ) && LIBOPIE2CORE
    comment "libopie2db needs a libqpe and libopie2core"
    depends !(( LIBQPE || LIBQPE-X11 ) && LIBOPIE2CORE)
```

## libopie2/opiemm/config.in
```kconfig
  config LIBOPIE2MM
    boolean "libopie2mm (audio and video related classes)"
    default "y"
    depends ( LIBQPE || LIBQPE-X11 ) && LIBOPIE2CORE
    comment "libopie2mm needs a libqpe and libopie2core"
    depends !(( LIBQPE || LIBQPE-X11 ) && LIBOPIE2CORE)
```

## libopie2/opienet/config.in
```kconfig
  config LIBOPIE2NET
    boolean "libopie2net (network and packet capturing related classes)"
    default "n"
    depends ( LIBQPE || LIBQPE-X11 ) && LIBOPIE2CORE
    comment "libopie2net needs a libqpe and libopie2core"
    depends !(( LIBQPE || LIBQPE-X11 ) && LIBOPIE2CORE)
```

## libopie2/opiepim/config.in
```kconfig
  config LIBOPIE2PIM
    boolean "libopie2pim (pim related classes)"
    default "y"
    depends ( LIBQPE || LIBQPE-X11 ) && LIBOPIE2CORE && ( LIBOPIE2DB || !LIBOPIE2DB )
    comment "libopie2pim needs a libqpe and libopie2core"
    depends !(( LIBQPE || LIBQPE-X11 ) && LIBOPIE2CORE && ( LIBOPIE2DB || !LIBOPIE2DB ))

  config SQL_PIM_BACKEND
    boolean "Enable SQL Backend for libopie2pim"
    default n
    help
	This adds the SQL-Support, using SQLite. Which database is used
	by the backends is defined by the file "pimaccess.conf" in the
	directory "Settings".
	There currently do exist to groups "[contact]" and "[todo]". You can
	select the used backend by the variable "usebackend=<type>", where
	<type> is "sql" or "xml". "xml" is the default !
	Important: The SQLite-library "libsqlite.so" must be installed !
    depends LIBOPIE2PIM && LIBOPIE2DB
    comment "SQL-Support needs libopie2pim and libopie2db (and libsqlite)"
    depends !( LIBOPIE2PIM && LIBOPIE2DB )
```

## libopie2/opiesecurity/config.in
```kconfig
  config LIBOPIE2SECURITY
    boolean "libopie2security (plugin-based authentication library for Opie)"
    default "y"
    depends ( LIBQPE || LIBQPE-X11 ) && LIBOPIE2CORE && LIBOPIE2UI
```

## libopie2/opieui/config.in
```kconfig
  config LIBOPIE2UI
    boolean "libopie2ui (user interface related classes)"
    default "n"
    depends ( LIBQPE || LIBQPE-X11 ) && LIBOPIE2CORE
    comment "libopie2ui needs a libqpe and libopie2core"
    depends !(( LIBQPE || LIBQPE-X11 ) && LIBOPIE2CORE)
```

## libslcompat/config.in
```kconfig
  config LIBSLCOMPAT
    boolean "Sharp libsl compatibility library"
    default "n"
    depends on LIBOPIE2UI
```

## noncore/applets/autorotateapplet/config.in
```kconfig
  config AUTOROTATEAPPLET
    boolean "opie-autorotate applet ( disables screen rotation based on the orientation of the device)"
    default "y"
    depends ( LIBQPE || LIBQPE-X11 ) && LIBOPIE2CORE
```

## noncore/applets/brightnessapplet/config.in
```kconfig
  config BRIGHTNESSAPPLET
    boolean "opie-brightness (control lcd brightness on-the-fly)"
    default "n"
    depends ( LIBQPE || LIBQPE-X11 ) && LIBOPIE2CORE && LIBOPIE2UI
    comment "Network applet needs a libqpe and libopie2 (core, ui)"
    depends !(( LIBQPE || LIBQPE-X11 ) && LIBOPIE2CORE && LIBOPIE2UI)
```

## noncore/applets/cardapplet/config.in
```kconfig
  config CARD-APPLET
    boolean "opie-cardapplet (monitor and configure pcmcia/cf/sd cards)"
    default "y"
    depends ( LIBQPE || LIBQPE-X11 ) && LIBOPIE2CORE
```

## noncore/applets/keyhelper/config.in
```kconfig
  config KEYHELPER
    boolean "keyhelper applet (Config keyboard layout on the fly)"
    default "n"
    depends ( LIBQPE || LIBQPE-X11 ) && LIBOPIE2CORE
```

## noncore/applets/memoryapplet/config.in
```kconfig
  config MEMORYAPPLET
    boolean "opie-memoryapplet (view memory status and manage a swap file)"
    default "y"
    depends ( LIBQPE || LIBQPE-X11 ) && LIBOPIE2UI && SYSINFO
  comment "opie-memoryapplet needs a libqpe, libopie and sysinfo"
    depends ! ( LIBOPIE && SYSINFO )
```

## noncore/applets/networkapplet/config.in
```kconfig
  config NETWORKAPPLET
    boolean "Network (control network interfaces on-the-fly)"
    default "n"
    depends ( LIBQPE || LIBQPE-X11 ) && LIBOPIE2CORE && LIBOPIE2UI && LIBOPIE2NET
    comment "Network applet needs a libqpe and libopie2 (core, ui, net)"
    depends !(( LIBQPE || LIBQPE-X11 ) && LIBOPIE2CORE && LIBOPIE2UI && LIBOPIE2NET)
```

## noncore/applets/notesapplet/config.in
```kconfig
  config NOTESAPPLET
    boolean "opie-notesapplet (quick note taking applet)"
    default "y"
    depends ( LIBQPE || LIBQPE-X11 ) 
```

## noncore/applets/pcmcia/config.in
```kconfig
  config PCMCIA-APPLET
    boolean "opie-pcmciaapplet (monitor and configure pcmcia/cf cards)"
    default "y"
    depends ( LIBQPE || LIBQPE-X11 ) && LIBOPIE2CORE
```
